## my_hello_app/build/Kconfig/boards/Kconfig.defconfig
```kconfig
# Load Zephyr board defconfig descriptions.
osource "D:/Downloads/zephyr_new/zephyr_guanfang/zephyr/boards/st/stm32f4_disco/Kconfig.defconfig"
```

## my_hello_app/build/Kconfig/boards/Kconfig.stm32f4_disco
```kconfig
# Load board Kconfig descriptions.
osource "D:/Downloads/zephyr_new/zephyr_guanfang/zephyr/boards/st/stm32f4_disco/Kconfig.stm32f4_disco"
```

## my_hello_app/build/Kconfig/boards/Kconfig.sysbuild
```kconfig
# Load Sysbuild board Kconfig descriptions.
osource "D:/Downloads/zephyr_new/zephyr_guanfang/zephyr/boards/st/stm32f4_disco/Kconfig.sysbuild"
```

## new/blinky/boards/arm/stm32f407_balance_car/Kconfig.stm32f407_balance_car
```kconfig
config BOARD_STM32F407_BALANCE_CAR 
    bool "STM32F407_BALANCE_CAR_F"
    select SOC_STM32F4X
    help
        My Board is baka.
```

## new/blinky/boards/arm/stm32f407_balance_car/stm32f407_balance_car_defconfig
```kconfig
# BOARD_STM32F407_BALANCE_CAR=y
#gpio
CONFIG_GPIO=y
#clock 
# CONFIG_CLOCK_CONTROL=y
# CONFIG_CLOCK_CONTROL_STM32_CUBE=y

#enable MPU

CONFIG_ARM_MPU=y
CONFIG_HW_STACK_PROTECTION=y
CONFIG_SERIAL=y

#console

CONFIG_CONSOLE=y
CONFIG_UART_CONSOLE=y


#H7 有特殊
#CONFIG STM32 ENABLE DEBUG_SLEEP_STOP=y
```

## new/blinky/build/Kconfig/Kconfig.shield.defconfig
```kconfig
osource "D:/Downloads/zephyr_new/myapp/new/blinky/boards/shields/*/Kconfig.defconfig"
```

## new/blinky/build/Kconfig/boards/Kconfig
```kconfig
# Load Zephyr board Kconfig descriptions.
osource "D:/Downloads/zephyr_new/myapp/new/blinky/boards/arm/stm32f407_balance_car/Kconfig"
```

## new/blinky/build/Kconfig/boards/Kconfig.defconfig
```kconfig
# Load Zephyr board defconfig descriptions.
osource "D:/Downloads/zephyr_new/myapp/new/blinky/boards/arm/stm32f407_balance_car/Kconfig.defconfig"
```

## new/blinky/cmake-build-debug-zephyr/Kconfig/arch/Kconfig
```kconfig
# Load Zephyr Arch Kconfig descriptions.
osource "D:/Downloads/zephyr_new/zephyr_guanfang/zephyr/arch/rx/Kconfig"
osource "D:/Downloads/zephyr_new/zephyr_guanfang/zephyr/arch/x86/Kconfig"
osource "D:/Downloads/zephyr_new/zephyr_guanfang/zephyr/arch/xtensa/Kconfig"
osource "D:/Downloads/zephyr_new/zephyr_guanfang/zephyr/arch/sparc/Kconfig"
osource "D:/Downloads/zephyr_new/zephyr_guanfang/zephyr/arch/riscv/Kconfig"
osource "D:/Downloads/zephyr_new/zephyr_guanfang/zephyr/arch/posix/Kconfig"
osource "D:/Downloads/zephyr_new/zephyr_guanfang/zephyr/arch/openrisc/Kconfig"
osource "D:/Downloads/zephyr_new/zephyr_guanfang/zephyr/arch/mips/Kconfig"
osource "D:/Downloads/zephyr_new/zephyr_guanfang/zephyr/arch/arm64/Kconfig"
osource "D:/Downloads/zephyr_new/zephyr_guanfang/zephyr/arch/arm/Kconfig"
osource "D:/Downloads/zephyr_new/zephyr_guanfang/zephyr/arch/arc/Kconfig"
```

## new/blinky/cmake-build-debug-zephyr/Kconfig/boards/Kconfig.stm32f407_balance_car
```kconfig
# Load board Kconfig descriptions.
osource "D:/Downloads/zephyr_new/myapp/new/blinky/boards/arm/stm32f407_balance_car/Kconfig.stm32f407_balance_car"
```

## new/boards/arm/stm32f407_balance_car/Kconfig.stm32f407_balance_car
```kconfig
config BOARD_STM32F407_BALANCE_CAR 
    bool "STM32F407_BALANCE_CAR_F"
    select SOC_STM32F407XE
    help
        My Board is baka.
```

## new/boards/arm/stm32f407_balance_car/board.yml
```yaml
board:
  name: stm32f407_balance_car
  full_name: STM32F407_BALANCE_CAR_F
  vendor: st
  socs:
    - name: stm32f407xx
```

## new/car_2026/cmake-build-debug-zephyr/Kconfig/Kconfig.shield.defconfig
```kconfig
osource "D:/Downloads/zephyr_new/myapp/new/boards/shields/*/Kconfig.defconfig"
osource "D:/Downloads/zephyr_new/myapp/new/car_2026/boards/shields/*/Kconfig.defconfig"
```

## new/car_2026/cmake-build-debug-zephyr/Kconfig/boards/Kconfig
```kconfig
# Load Zephyr board Kconfig descriptions.
osource "D:/Downloads/zephyr_new/myapp/new/boards/arm/stm32f407_balance_car/Kconfig"
```

## new/car_2026/cmake-build-debug-zephyr/Kconfig/boards/Kconfig.defconfig
```kconfig
# Load Zephyr board defconfig descriptions.
osource "D:/Downloads/zephyr_new/myapp/new/boards/arm/stm32f407_balance_car/Kconfig.defconfig"
```

## new/car_2026/cmake-build-debug-zephyr/Kconfig/soc/Kconfig
```kconfig
# Load Zephyr SoC Kconfig descriptions.
osource "D:/Downloads/zephyr_new/zephyr_guanfang/zephyr/soc/xlnx/zynqmp/Kconfig"
osource "D:/Downloads/zephyr_new/zephyr_guanfang/zephyr/soc/xlnx/zynq7000/Kconfig"
osource "D:/Downloads/zephyr_new/zephyr_guanfang/zephyr/soc/xlnx/versalnet/Kconfig"
osource "D:/Downloads/zephyr_new/zephyr_guanfang/zephyr/soc/xlnx/versal2/Kconfig"
osource "D:/Downloads/zephyr_new/zephyr_guanfang/zephyr/soc/xlnx/versal/Kconfig"
osource "D:/Downloads/zephyr_new/zephyr_guanfang/zephyr/soc/xen/Kconfig"
osource "D:/Downloads/zephyr_new/zephyr_guanfang/zephyr/soc/wch/ch32v/Kconfig"
osource "D:/Downloads/zephyr_new/zephyr_guanfang/zephyr/soc/ti/simplelink/Kconfig"
osource "D:/Downloads/zephyr_new/zephyr_guanfang/zephyr/soc/ti/mspm/Kconfig"
osource "D:/Downloads/zephyr_new/zephyr_guanfang/zephyr/soc/ti/lm3s6965/Kconfig"
osource "D:/Downloads/zephyr_new/zephyr_guanfang/zephyr/soc/ti/k3/Kconfig"
osource "D:/Downloads/zephyr_new/zephyr_guanfang/zephyr/soc/ti/am13/Kconfig"
osource "D:/Downloads/zephyr_new/zephyr_guanfang/zephyr/soc/telink/tlsr/Kconfig"
osource "D:/Downloads/zephyr_new/zephyr_guanfang/zephyr/soc/syna/sr100/Kconfig"
osource "D:/Downloads/zephyr_new/zephyr_guanfang/zephyr/soc/starfive/jh71xx/Kconfig"
osource "D:/Downloads/zephyr_new/zephyr_guanfang/zephyr/soc/st/stm32/Kconfig"
osource "D:/Downloads/zephyr_new/zephyr_guanfang/zephyr/soc/snps/qemu_arc/Kconfig"
osource "D:/Downloads/zephyr_new/zephyr_guanfang/zephyr/soc/snps/nsim/arc_v/Kconfig"
osource "D:/Downloads/zephyr_new/zephyr_guanfang/zephyr/soc/snps/nsim/arc_classic/Kconfig"
osource "D:/Downloads/zephyr_new/zephyr_guanfang/zephyr/soc/snps/hsdk4xd/Kconfig"
osource "D:/Downloads/zephyr_new/zephyr_guanfang/zephyr/soc/snps/hsdk/Kconfig"
osource "D:/Downloads/zephyr_new/zephyr_guanfang/zephyr/soc/snps/emsk/Kconfig"
osource "D:/Downloads/zephyr_new/zephyr_guanfang/zephyr/soc/snps/emsdp/Kconfig"
osource "D:/Downloads/zephyr_new/zephyr_guanfang/zephyr/soc/snps/arc_iot/Kconfig"
osource "D:/Downloads/zephyr_new/zephyr_guanfang/zephyr/soc/silabs/Kconfig"
osource "D:/Downloads/zephyr_new/zephyr_guanfang/zephyr/soc/sifli/sf32/Kconfig"
osource "D:/Downloads/zephyr_new/zephyr_guanfang/zephyr/soc/sifive/sifive_freedom/Kconfig"
osource "D:/Downloads/zephyr_new/zephyr_guanfang/zephyr/soc/shakti/Kconfig"
osource "D:/Downloads/zephyr_new/zephyr_guanfang/zephyr/soc/sensry/Kconfig"
osource "D:/Downloads/zephyr_new/zephyr_guanfang/zephyr/soc/rockchip/Kconfig"
osource "D:/Downloads/zephyr_new/zephyr_guanfang/zephyr/soc/renode/riscv_virtual/Kconfig"
osource "D:/Downloads/zephyr_new/zephyr_guanfang/zephyr/soc/renode/cortex_r8_virtual/Kconfig"
osource "D:/Downloads/zephyr_new/zephyr_guanfang/zephyr/soc/renesas/smartbond/Kconfig"
osource "D:/Downloads/zephyr_new/zephyr_guanfang/zephyr/soc/renesas/rz/Kconfig"
osource "D:/Downloads/zephyr_new/zephyr_guanfang/zephyr/soc/renesas/rx/Kconfig"
osource "D:/Downloads/zephyr_new/zephyr_guanfang/zephyr/soc/renesas/rcar/Kconfig"
osource "D:/Downloads/zephyr_new/zephyr_guanfang/zephyr/soc/renesas/ra/Kconfig"
osource "D:/Downloads/zephyr_new/zephyr_guanfang/zephyr/soc/realtek/fingerprint/Kconfig"
osource "D:/Downloads/zephyr_new/zephyr_guanfang/zephyr/soc/realtek/ec/Kconfig"
osource "D:/Downloads/zephyr_new/zephyr_guanfang/zephyr/soc/realtek/bee/Kconfig"
osource "D:/Downloads/zephyr_new/zephyr_guanfang/zephyr/soc/realtek/ameba/Kconfig"
osource "D:/Downloads/zephyr_new/zephyr_guanfang/zephyr/soc/raspberrypi/rpi_pico/Kconfig"
osource "D:/Downloads/zephyr_new/zephyr_guanfang/zephyr/soc/quicklogic/eos_s3/Kconfig"
osource "D:/Downloads/zephyr_new/zephyr_guanfang/zephyr/soc/qemu/virt_riscv/Kconfig"
osource "D:/Downloads/zephyr_new/zephyr_guanfang/zephyr/soc/qemu/or1k/Kconfig"
osource "D:/Downloads/zephyr_new/zephyr_guanfang/zephyr/soc/qemu/malta/Kconfig"
osource "D:/Downloads/zephyr_new/zephyr_guanfang/zephyr/soc/openisa/rv32m1/Kconfig"
osource "D:/Downloads/zephyr_new/zephyr_guanfang/zephyr/soc/openhwgroup/cva6/Kconfig"
osource "D:/Downloads/zephyr_new/zephyr_guanfang/zephyr/soc/oct/osd32mp15x/Kconfig"
osource "D:/Downloads/zephyr_new/zephyr_guanfang/zephyr/soc/nxp/s32/Kconfig"
osource "D:/Downloads/zephyr_new/zephyr_guanfang/zephyr/soc/nxp/rw/Kconfig"
osource "D:/Downloads/zephyr_new/zephyr_guanfang/zephyr/soc/nxp/mcx/Kconfig"
osource "D:/Downloads/zephyr_new/zephyr_guanfang/zephyr/soc/nxp/lpc/Kconfig"
osource "D:/Downloads/zephyr_new/zephyr_guanfang/zephyr/soc/nxp/layerscape/Kconfig"
osource "D:/Downloads/zephyr_new/zephyr_guanfang/zephyr/soc/nxp/kinetis/Kconfig"
osource "D:/Downloads/zephyr_new/zephyr_guanfang/zephyr/soc/nxp/imxrt/Kconfig"
osource "D:/Downloads/zephyr_new/zephyr_guanfang/zephyr/soc/nxp/imx/Kconfig"
osource "D:/Downloads/zephyr_new/zephyr_guanfang/zephyr/soc/nuvoton/numicro/Kconfig"
osource "D:/Downloads/zephyr_new/zephyr_guanfang/zephyr/soc/nuvoton/numaker/Kconfig"
osource "D:/Downloads/zephyr_new/zephyr_guanfang/zephyr/soc/nuvoton/npcx/Kconfig"
osource "D:/Downloads/zephyr_new/zephyr_guanfang/zephyr/soc/nuvoton/npcm/Kconfig"
osource "D:/Downloads/zephyr_new/zephyr_guanfang/zephyr/soc/nordic/Kconfig"
osource "D:/Downloads/zephyr_new/zephyr_guanfang/zephyr/soc/neorv32/Kconfig"
osource "D:/Downloads/zephyr_new/zephyr_guanfang/zephyr/soc/native/inf_clock/Kconfig"
osource "D:/Downloads/zephyr_new/zephyr_guanfang/zephyr/soc/microchip/smartfusion2/Kconfig"
osource "D:/Downloads/zephyr_new/zephyr_guanfang/zephyr/soc/microchip/sam/sama7/Kconfig"
osource "D:/Downloads/zephyr_new/zephyr_guanfang/zephyr/soc/microchip/sam/sam_d5x_e5x/Kconfig"
osource "D:/Downloads/zephyr_new/zephyr_guanfang/zephyr/soc/microchip/pic64/Kconfig"
osource "D:/Downloads/zephyr_new/zephyr_guanfang/zephyr/soc/microchip/pic32c/pic32cz_ca/Kconfig"
osource "D:/Downloads/zephyr_new/zephyr_guanfang/zephyr/soc/microchip/pic32c/pic32cx_sg/Kconfig"
osource "D:/Downloads/zephyr_new/zephyr_guanfang/zephyr/soc/microchip/pic32c/pic32cm_sg_gc/Kconfig"
osource "D:/Downloads/zephyr_new/zephyr_guanfang/zephyr/soc/microchip/pic32c/pic32cm_pl/Kconfig"
osource "D:/Downloads/zephyr_new/zephyr_guanfang/zephyr/soc/microchip/pic32c/pic32cm_jh/Kconfig"
osource "D:/Downloads/zephyr_new/zephyr_guanfang/zephyr/soc/microchip/pic32c/pic32ck_sg_gc/Kconfig"
osource "D:/Downloads/zephyr_new/zephyr_guanfang/zephyr/soc/microchip/miv/Kconfig"
osource "D:/Downloads/zephyr_new/zephyr_guanfang/zephyr/soc/microchip/mec/Kconfig"
osource "D:/Downloads/zephyr_new/zephyr_guanfang/zephyr/soc/mediatek/mt8xxx/Kconfig"
osource "D:/Downloads/zephyr_new/zephyr_guanfang/zephyr/soc/lowrisc/opentitan/Kconfig"
osource "D:/Downloads/zephyr_new/zephyr_guanfang/zephyr/soc/litex/Kconfig"
osource "D:/Downloads/zephyr_new/zephyr_guanfang/zephyr/soc/ite/ec/Kconfig"
osource "D:/Downloads/zephyr_new/zephyr_guanfang/zephyr/soc/intel/wildcat_lake/Kconfig"
osource "D:/Downloads/zephyr_new/zephyr_guanfang/zephyr/soc/intel/raptor_lake/Kconfig"
osource "D:/Downloads/zephyr_new/zephyr_guanfang/zephyr/soc/intel/panther_lake/Kconfig"
osource "D:/Downloads/zephyr_new/zephyr_guanfang/zephyr/soc/intel/nova_lake/Kconfig"
osource "D:/Downloads/zephyr_new/zephyr_guanfang/zephyr/soc/intel/lakemont/Kconfig"
osource "D:/Downloads/zephyr_new/zephyr_guanfang/zephyr/soc/intel/intel_socfpga_std/Kconfig"
osource "D:/Downloads/zephyr_new/zephyr_guanfang/zephyr/soc/intel/intel_socfpga/Kconfig"
osource "D:/Downloads/zephyr_new/zephyr_guanfang/zephyr/soc/intel/intel_niosv/Kconfig"
osource "D:/Downloads/zephyr_new/zephyr_guanfang/zephyr/soc/intel/intel_ish/Kconfig"
osource "D:/Downloads/zephyr_new/zephyr_guanfang/zephyr/soc/intel/intel_adsp/Kconfig"
osource "D:/Downloads/zephyr_new/zephyr_guanfang/zephyr/soc/intel/elkhart_lake/Kconfig"
osource "D:/Downloads/zephyr_new/zephyr_guanfang/zephyr/soc/intel/atom/Kconfig"
osource "D:/Downloads/zephyr_new/zephyr_guanfang/zephyr/soc/intel/apollo_lake/Kconfig"
osource "D:/Downloads/zephyr_new/zephyr_guanfang/zephyr/soc/intel/alder_lake/Kconfig"
osource "D:/Downloads/zephyr_new/zephyr_guanfang/zephyr/soc/infineon/psoc4/Kconfig"
osource "D:/Downloads/zephyr_new/zephyr_guanfang/zephyr/soc/infineon/edge/Kconfig"
osource "D:/Downloads/zephyr_new/zephyr_guanfang/zephyr/soc/infineon/cat3/Kconfig"
osource "D:/Downloads/zephyr_new/zephyr_guanfang/zephyr/soc/infineon/cat1c/Kconfig"
osource "D:/Downloads/zephyr_new/zephyr_guanfang/zephyr/soc/infineon/cat1b/Kconfig"
osource "D:/Downloads/zephyr_new/zephyr_guanfang/zephyr/soc/infineon/cat1a/Kconfig"
osource "D:/Downloads/zephyr_new/zephyr_guanfang/zephyr/soc/gd/gd32/Kconfig"
osource "D:/Downloads/zephyr_new/zephyr_guanfang/zephyr/soc/gaisler/leon3/Kconfig"
osource "D:/Downloads/zephyr_new/zephyr_guanfang/zephyr/soc/gaisler/gr716a/Kconfig"
osource "D:/Downloads/zephyr_new/zephyr_guanfang/zephyr/soc/focaltech/Kconfig"
osource "D:/Downloads/zephyr_new/zephyr_guanfang/zephyr/soc/espressif/Kconfig"
osource "D:/Downloads/zephyr_new/zephyr_guanfang/zephyr/soc/ene/kb1200/Kconfig"
osource "D:/Downloads/zephyr_new/zephyr_guanfang/zephyr/soc/ene/kb106x/Kconfig"
osource "D:/Downloads/zephyr_new/zephyr_guanfang/zephyr/soc/elan/em32f967/Kconfig"
osource "D:/Downloads/zephyr_new/zephyr_guanfang/zephyr/soc/egis/Kconfig"
osource "D:/Downloads/zephyr_new/zephyr_guanfang/zephyr/soc/efinix/sapphire/Kconfig"
osource "D:/Downloads/zephyr_new/zephyr_guanfang/zephyr/soc/cdns/xtensa_sample_controller/Kconfig"
osource "D:/Downloads/zephyr_new/zephyr_guanfang/zephyr/soc/cdns/swerv/Kconfig"
osource "D:/Downloads/zephyr_new/zephyr_guanfang/zephyr/soc/cdns/sample_controller32/Kconfig"
osource "D:/Downloads/zephyr_new/zephyr_guanfang/zephyr/soc/cdns/dc233c/Kconfig"
osource "D:/Downloads/zephyr_new/zephyr_guanfang/zephyr/soc/brcm/bcmvk/Kconfig"
osource "D:/Downloads/zephyr_new/zephyr_guanfang/zephyr/soc/brcm/bcm2712/Kconfig"
osource "D:/Downloads/zephyr_new/zephyr_guanfang/zephyr/soc/brcm/bcm2711/Kconfig"
osource "D:/Downloads/zephyr_new/zephyr_guanfang/zephyr/soc/blackberry/qnxhv_vm/Kconfig"
osource "D:/Downloads/zephyr_new/zephyr_guanfang/zephyr/soc/bflb/Kconfig"
osource "D:/Downloads/zephyr_new/zephyr_guanfang/zephyr/soc/atmel/sam0/Kconfig"
osource "D:/Downloads/zephyr_new/zephyr_guanfang/zephyr/soc/atmel/sam/Kconfig"
osource "D:/Downloads/zephyr_new/zephyr_guanfang/zephyr/soc/aspeed/Kconfig"
osource "D:/Downloads/zephyr_new/zephyr_guanfang/zephyr/soc/arm/Kconfig"
osource "D:/Downloads/zephyr_new/zephyr_guanfang/zephyr/soc/arm/beetle/Kconfig"
osource "D:/Downloads/zephyr_new/zephyr_guanfang/zephyr/soc/antmicro/myra/Kconfig"
osource "D:/Downloads/zephyr_new/zephyr_guanfang/zephyr/soc/andestech/Kconfig"
osource "D:/Downloads/zephyr_new/zephyr_guanfang/zephyr/soc/amd/acp_7_x/Kconfig"
osource "D:/Downloads/zephyr_new/zephyr_guanfang/zephyr/soc/amd/acp_7_0/Kconfig"
osource "D:/Downloads/zephyr_new/zephyr_guanfang/zephyr/soc/amd/acp_6_0/Kconfig"
osource "D:/Downloads/zephyr_new/zephyr_guanfang/zephyr/soc/ambiq/Kconfig"
osource "D:/Downloads/zephyr_new/zephyr_guanfang/zephyr/soc/allwinner/sun8i_h3/Kconfig"
osource "D:/Downloads/zephyr_new/zephyr_guanfang/zephyr/soc/allwinner/sun50i_h618/Kconfig"
osource "D:/Downloads/zephyr_new/zephyr_guanfang/zephyr/soc/alif/ensemble/Kconfig"
osource "D:/Downloads/zephyr_new/zephyr_guanfang/zephyr/soc/alif/balletto/Kconfig"
osource "D:/Downloads/zephyr_new/zephyr_guanfang/zephyr/soc/aesc/Kconfig"
osource "D:/Downloads/zephyr_new/zephyr_guanfang/zephyr/soc/adi/max32/Kconfig"
```

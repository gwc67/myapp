## CMakeLists.txt
```
# SPDX-License-Identifier: Apache-2.0

cmake_minimum_required(VERSION 3.28.0)
set(BOARD_ROOT ${CMAKE_CURRENT_SOURCE_DIR})

# 直接 cmake 构建 (不走 west) 时模块系统不会自动加载 hal_stm32,
# 导致 board dts 里的 #include <st/f4/stm32f407z(e-g)tx-pinctrl.dtsi> 解析不到.
# 这里手动把 hal_stm32 模块的 dts 根注册进 DTS_ROOT, 让 pinctrl 定义可见.
list(APPEND DTS_ROOT "$ENV{ZEPHYR_BASE}/../modules/hal/stm32")

find_package(Zephyr REQUIRED HINTS $ENV{ZEPHYR_BASE})
project(car_2026)

target_sources(app PRIVATE
    src/main.c
    # src/menu/menu_input.c
    # src/menu/menu.c
    # src/menu/OLED_Menu.c
    # src/menu/font.c
    # src/ano/ano_true.c
    # src/ano/ano_base.c
    # src/ano/ano_board_init.c
    # src/ano/ano_device/ano_device_com.c
    # src/uart/uart_base.c
    # src/uart/uart_it.c
    # src/uart/uart_dma.c
    # src/uart/uart_board_init.c
    # src/my_ring/my_ring.c
    # src/mpu6050/mpu6050.c
    # src/mpu6050/euler.c
    # src/mess/value_to_str.c
    # src/encode/encode.c
    # src/motor/tb6612.c
    # src/key/key.c
    # src/simulink/ARMCortex-M/blinky/blinky.c
    # src/simulink/ARMCortex-M/blinky/rtmodel.c
    # src/simulink/ARMCortex-M/blinky/blinky_data.c
    # src/debug/debug.c
    
)

target_include_directories(app PRIVATE
    src
    # src/menu
    # src/ano
    # src/ano/ano_device
    # src/uart
    # src/my_ring
    # src/mpu6050
    # src/mess
    # src/encode
    # src/motor
    # src/key
    # src/simulink/ARMCortex-M/blinky
    # src/debug
)
```

## prj.conf
```kconfig
CONFIG_SYS_CLOCK_EXISTS=y
CONFIG_DEBUG=y
CONFIG_SYS_CLOCK_TICKS_PER_SEC=1000

######  OLED #####
#SSD1306

#enable I2c
# CONFIG_I2C=y

#enable SSD1306 display
# CONFIG_SSD1306=y

#enable display subsystem
# CONFIG_DISPLAY=y

#cfb 字符帧缓冲(提供 cfb_* API)
# CONFIG_CHARACTER_FRAMEBUFFER=y

# 禁用内置默认字体，只用自己的
# CONFIG_CHARACTER_FRAMEBUFFER_USE_DEFAULT_FONTS=n

#cfb 内部用 k_malloc 分配帧缓冲，需要内核堆
CONFIG_HEAP_MEM_POOL_SIZE=2048


#MPU6050
CONFIG_SENSOR=y
CONFIG_MPU6050=y

#如果使用lvgl
#CONFIG_LVGL=y

#按键 Input Subsystem(可选)

CONFIG_INPUT=y
CONFIG_INPUT_GPIO_KEYS=y

#shell(i2c scan调试)
# CONFIG_SHELL=y
# CONFIG_I2C_SHELL=y


#串口
CONFIG_SERIAL=y
CONFIG_UART_INTERRUPT_DRIVEN=y      #中断驱动
CONFIG_DMA=y                        #开启DMA
CONFIG_DMA_STM32=y
CONFIG_RING_BUFFER=y                #环形缓冲区 (IT 模式 TX)
CONFIG_UART_INTERRUPT_DRIVEN=y      #uart_it 开启
CONFIG_UART_ASYNC_API=y             #异步开启

#断言支持 调试状态下使用 控制台调试
CONFIG_ASSERT=y
# INF 级别
CONFIG_LOG_DEFAULT_LEVEL=3          
CONFIG_LOG=y
CONFIG_LOG_BACKEND_UART=y
CONFIG_CONSOLE=y

#开启编码器
CONFIG_QDEC_STM32=y

#定时器
CONFIG_COUNTER=y
CONFIG_COUNTER_TIMER_STM32=y

# PWM 开启motor
CONFIG_PWM=y
CONFIG_GPIO=y
```

## src/main.c
```c
#include "zephyr/device.h"
#include "zephyr/drivers/gpio.h"
#include "zephyr/kernel.h"

static K_THREAD_STACK_DEFINE(s_stack_5ms_high, 4096); /* 1.5KB */
static struct k_thread s_thread_5ms_high;

static const struct gpio_dt_spec led0 = GPIO_DT_SPEC_GET(DT_ALIAS(led0),gpios);


void s_task_5ms_high(void *p1,void *p2,void *p3 )
{
    k_sleep(K_MSEC(1000));
}

int main(void)
{

    k_thread_create(&s_thread_5ms_high, s_stack_5ms_high, sizeof(s_stack_5ms_high), s_task_5ms_high, NULL, NULL, NULL, K_PRIO_PREEMPT(4), 0, K_NO_WAIT);
    gpio_pin_set_dt(&led0, 0);
    k_sleep(K_MSEC(1000));
    gpio_pin_set_dt(&led0, 1);
    while (1) {

	}
	return 0;
}
```
